// MATRIX 8x8
#include "main.h"

#define SCK &PORTD, PD0
#define LAT &PORTD, PD1
#define DATA &PORTD, PD2

#define MATRIX_WIDTH 40
#define MATRIX_HEIGHT 8

unsigned char FONT[][8] = {
    {0x00, 0x00, 0x00, 0x00, 0x00, 0x00, 0x00}, //  32
    {0x10, 0x38, 0x38, 0x10, 0x10, 0x00, 0x10}, //! 33
    {0x6C, 0x6C, 0x48, 0x00, 0x00, 0x00, 0x00}, //" 34
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    {0x00, 0x00, 0x28, 0x50, 0x00, 0x00, 0x00}, //~ 126
};
unsigned char SCAN8x8[8] = {0xFE, 0xFD, 0xFB, 0xF7, 0xEF, 0xDF, 0xBF, 0x7F};
unsigned char BUFFER_DISPLAY[MATRIX_HEIGHT][MATRIX_WIDTH / 8];
unsigned char BUFFER_DISPLAY_TEMP[MATRIX_HEIGHT][MATRIX_WIDTH / 8];

int MATRIX_x, MATRIX_y;

static void GPIO_Init(void);
static void TIMER1_Init(void);
void _74HC595_Out(unsigned char byte);
void MATRIX8x8_SetPosition(int x, int y);
void MATRIX8x8_SetPixel(int x, int y, int status);
void MATRIX8x8_Clear(void);
void MATRIX8x8_Update(void);
void MATRIX8x8_SendChar(char character);
void MATRIX8x8_SendString(char *string);

ISR(TIMER1_OVF_vect)
{
    static unsigned char k;
    PORTB = 0xff;

    for (int x = (MATRIX_WIDTH / 8) - 1; x >= 0; x--)
    {
        _74HC595_Out(BUFFER_DISPLAY_TEMP[k][x]);
    }

    GPIO_WritePin(LAT, 0);
    GPIO_WritePin(LAT, 1);

    PORTB = SCAN8x8[k];
    k++;
    if (k == 8)
        k = 0;

    TCNT1 = 65411;
}

int main()
{
    DS1307 rtc;
    DS1307_SetTime(1, 20, 2);
    DS1307_SetDate(15, 9, 22);
    GPIO_Init();
    TIMER1_Init();

    while (1)
    {
        MATRIX8x8_Clear();
        DS1307_GetDateTime(&rtc);
        MATRIX8x8_SetPosition(0, 0);
        MATRIX8x8_SendChar(rtc.second / 10 + 48);
        MATRIX8x8_Update();
        // MATRIX8x8_Clear();
        // for (int i = MATRIX_WIDTH - 1; i > -200; i--)
        // {
        //   MATRIX8x8_SetPosition(i, 0);
        //   MATRIX8x8_SendString("DOAN KHIET THANH");
        //   MATRIX8x8_Update();
        //   _delay_ms(20);
        // }
    }

    return 0;
}

static void GPIO_Init(void)
{
    DDRB = 0xFF;
    DDRD = 0xFF;
}

static void TIMER1_Init(void)
{
    cli();

    TCCR1A = 0;
    TCCR1B = 0;
    TIMSK1 = 0;
    TCCR1B |= (1 << CS11); // prescale = 8
    TCNT1 = 65411;         // period = 50ms
    TIMSK1 = (1 << TOIE1); // Overflow interrupt enable

    sei();
}

void _74HC595_Out(unsigned char byte)
{
    for (int i = 0; i < 8; i++)
    {
        GPIO_WritePin(DATA, byte & (0x80 >> i));
        GPIO_WritePin(SCK, 0);
        GPIO_WritePin(SCK, 1);
    }
}

void MATRIX8x8_SetPosition(int x, int y)
{
    MATRIX_x = x;
    MATRIX_y = y;
}

void MATRIX8x8_SetPixel(int x, int y, int status)
{
    if (x >= MATRIX_WIDTH || x < 0 || y >= MATRIX_HEIGHT || y < 0)
        return;
    if (status)
        BUFFER_DISPLAY[y][x / 8] |= (0x80 >> (x % 8));
    else
        BUFFER_DISPLAY[y][x / 8] &= ~(0x80 >> (x % 8));
}

void MATRIX8x8_SendChar(char character)
{
    for (int y = MATRIX_y; y < 8 + MATRIX_y; y++)
    {
        for (int x = MATRIX_x; x < 8 + MATRIX_x; x++)
        {
            if ((FONT[character - 32][y - MATRIX_y] & (0x80 >> (x - MATRIX_x))) != 0)
                MATRIX8x8_SetPixel(x, y, 1);
            else
                MATRIX8x8_SetPixel(x, y, 0);
        }
    }

    MATRIX_x += 8;
}

void MATRIX8x8_SendString(char *string)
{
    while (*string)
    {
        MATRIX8x8_SendChar(*string);
        string++;
    }
}

void MATRIX8x8_Clear(void)
{
    for (int y = 0; y < MATRIX_HEIGHT; y++)
    {
        for (int x = 0; x < (MATRIX_WIDTH / 8); x++)
        {
            BUFFER_DISPLAY_TEMP[y][x] = 0;
        }
    }
}

void MATRIX8x8_Update(void)
{
    for (int y = 0; y < MATRIX_HEIGHT; y++)
    {
        for (int x = 0; x < (MATRIX_WIDTH / 8); x++)
        {
            BUFFER_DISPLAY_TEMP[y][x] = BUFFER_DISPLAY[y][x];
        }
    }
}
